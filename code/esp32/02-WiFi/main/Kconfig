## code/esp32/02-WiFi/main/Kconfig
```kconfig
menu "GMaker Configuration"

    menu "LCD Pins Configuration"
        config GMAKER_LCD_CS_PIN
            int "LCD Chip Select Pin"
            default 5
            range 0 39
            help
                GPIO pin for LCD Chip Select

        config GMAKER_LCD_DC_PIN
            int "LCD Data/Command Pin"
            default 4
            range 0 39

        config GMAKER_LCD_RST_PIN
            int "LCD Reset Pin"
            default 22
            range 0 39

        config GMAKER_LCD_BACKLIGHT_PIN
            int "LCD Backlight Pin"
            default 15
            range 0 39
    endmenu

    menu "Touch Pins Configuration"
        config GMAKER_TOUCH_CS_PIN
            int "Touch Chip Select Pin"
            default 14
            range 0 39
    endmenu

    menu "SPI Configuration"
        config GMAKER_SPI_SCLK_PIN
            int "SPI Clock Pin"
            default 18
            range 0 39

        config GMAKER_SPI_MOSI_PIN
            int "SPI MOSI Pin"
            default 23
            range 0 39

        config GMAKER_SPI_MISO_PIN
            int "SPI MISO Pin"
            default 19
            range 0 39
    endmenu

    menu "WiFi Configuration"

        config GMAKER_WIFI_SSID
            string "WiFi SSID"
            default "MiRed"

        config GMAKER_WIFI_PASSWORD
            string "WiFi Password"
            default "MiPassword123"

    endmenu
endmenu
```

## code/esp32/04-SD/main/Kconfig
```kconfig
menu "GMaker Configuration"
    menu "SPI Configuration"
        config GMAKER_SPI_MISO
            int "SPI MISO Pin"
            default 12
            help
                Set the GPIO pin number for the MISO (Master In Slave Out) connection to the SPI bus.

        config GMAKER_SPI_MOSI
            int "SPI MOSI Pin"
            default 11
            help
                Set the GPIO pin number for the MOSI (Master Out Slave In) connection to the SPI bus.

        config GMAKER_SPI_CLK
            int "SPI CLK Pin"
            default 13
            help
                Set the GPIO pin number for the CLK (Clock) connection to the SPI bus.
    endmenu
    menu "SD Card Configuration"
        config GMAKER_SD_CS
            int "SD Card CS Pin"
            default 10
            help
                Set the GPIO pin number for the CS (Chip Select) connection to the SD card.
    endmenu
endmenu
```

## code/esp32/05-TOTP/main/Kconfig
```kconfig
menu "GMaker Configuration"
    menu "WiFi Configuration"
        config GMAKER_WIFI_SSID
            string "WiFi SSID"
            default "your_ssid"
            help
                SSID (network name) for the WiFi network to connect to.

        config GMAKER_WIFI_PASSWORD
            string "WiFi Password"
            default "your_password"
            help
                Password for the WiFi network.
    endmenu
endmenu
```

## code/esp32/07-Oled-buttons/main/Kconfig
```kconfig
menu "GMaker Configuration"
    menu "I2C Configuration"
    config GMAKER_I2C_SDA
        int "I2C SDA Pin"
        default 21
        help
            Set the GPIO pin number for the SDA (Serial Data) connection to the I2C bus.

    config GMAKER_I2C_SCL
        int "I2C SCL Pin"
        default 22
        help
            Set the GPIO pin number for the SCL (Serial Clock) connection to the I2C bus.
    endmenu
endmenu
```
